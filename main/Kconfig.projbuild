## main/Kconfig.projbuild
```kconfig
menu "OS project demonstrations"
    config APP_LEGACY_POOL_DEMO
        bool "Run the original fixed-block pool demo"
        default n
    config APP_INTERACTIVE_HEAP_LAB
        bool "Interactive heap lab over UART"
        depends on ESP_CONSOLE_UART && !APP_LEGACY_POOL_DEMO
        default n
        help
            Run the UART interface for tools/heap_lab.py. Turn this off to run
            the automated experiment suite at boot.
    config APP_CAMERA_DEMO
        bool "Image processing and temperature demo over UART"
        depends on ESP_CONSOLE_UART && !FREERTOS_UNICORE && !APP_LEGACY_POOL_DEMO && !APP_INTERACTIVE_HEAP_LAB
        default n
        help
            Compare two memory policies while both ESP32-S3 cores filter the same
            image and a periodic task reports chip temperature over UART.
    config APP_EXPERIMENT_REPEATS
        int "Repetitions per policy and scenario"
        range 1 20
        default 3
    config AH_SKIP_PER_CALL_VALIDATION
        bool "Skip invariant validation inside each ah_alloc/ah_free (latency measurement)"
        default n
        help
            Off (default): every ah_alloc/ah_free walks the whole arena to check
            invariants, as in the original design. TIMING rows then include that walk.
            On: the walk is skipped inside ah_alloc/ah_free; experiments still call
            ah_validate() at round boundaries. Use only for latency measurement runs.
endmenu
```

## sdkconfig.defaults
```kconfig
CONFIG_ESPTOOLPY_FLASHSIZE_16MB=y
CONFIG_ESPTOOLPY_FLASHMODE_DIO=y
CONFIG_ESP_DEFAULT_CPU_FREQ_MHZ_160=y
CONFIG_FREERTOS_HZ=100
# CONFIG_FREERTOS_UNICORE is not set
# CONFIG_SPIRAM is not set
# CONFIG_APP_LEGACY_POOL_DEMO is not set
CONFIG_APP_EXPERIMENT_REPEATS=3
```
